## boards/arm/corne_choc_single_left/Kconfig
```kconfig
# SPDX-License-Identifier: MIT

config BOARD_ENABLE_DCDC
	bool "Enable DCDC mode"
	select SOC_DCDC_NRF52X
	default y
	depends on (BOARD_CORNE_CHOC_SINGLE_LEFT_LEFT || BOARD_CORNE_CHOC_SINGLE_LEFT_RIGHT)
```

## boards/arm/corne_choc_single_left/Kconfig.board
```kconfig
# Copyright (c) 2020 The ZMK Contributors
# SPDX-License-Identifier: MIT

config BOARD_CORNE_CHOC_SINGLE_LEFT_BOARD
	bool "Corne Choc Single Left"
	depends on SOC_NRF52840_QIAA
```
