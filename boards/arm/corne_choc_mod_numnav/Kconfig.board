## boards/arm/corne_choc_mod_numnav/Kconfig.board
```kconfig
# Copyright (c) 2020 The ZMK Contributors
# SPDX-License-Identifier: MIT

config BOARD_CORNE_CHOC_MOD_NUMNAV_LEFT
	bool "Corne Choc Mod NumNav Left"
	depends on SOC_NRF52840_QIAA

config BOARD_CORNE_CHOC_MOD_NUMNAV_RIGHT
	bool "Corne Choc Mod NumNav Right"
	depends on SOC_NRF52840_QIAA
```

## boards/shields/perpetual/Kconfig.defconfig
```kconfig
# Copyright (c) 2024 Curtis Bollinger
# SPDX-License-Identifier: MIT

if SHIELD_PERPETUAL_LEFT

config ZMK_KEYBOARD_NAME
    default "Perpetual"

config ZMK_SPLIT_ROLE_CENTRAL
    default y

endif

if SHIELD_PERPETUAL_LEFT || SHIELD_PERPETUAL_RIGHT

config ZMK_SPLIT
    default y

endif
```

## boards/shields/perpetual/Kconfig.shield
```kconfig
# Copyright (c) 2024 Curtis Bollinger
# SPDX-License-Identifier: MIT

config SHIELD_PERPETUAL_LEFT
    def_bool $(shields_list_contains,perpetual_left)

config SHIELD_PERPETUAL_RIGHT
    def_bool $(shields_list_contains,perpetual_right)
```
